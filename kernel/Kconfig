## kernel/Kconfig
```kconfig
menu "KernelSU"

config KSU
	tristate "KernelSU function support"
	select KALLSYMS
	default y
	help
	  Enable kernel-level root privileges on Android System.
	  Choose "m" here to build KernelSU as LKM.

config KSU_DEBUG
	bool "KernelSU debug mode"
	depends on KSU
	default n
	help
	  Enable KernelSU debug mode.

config KSU_DISABLE_MANAGER
	bool "Disable KernelSU manager integration"
	depends on KSU
	default n
	help
	  Disable manager APK detection and manager-specific handling.
	  Root will be used in place of manager-only functionality.

config KSU_DISABLE_POLICY
	bool "Disable KernelSU policy profiles"
	depends on KSU
	default n
	help
	  Disable per-app root/non-root profile customization.
	  Escalation will always use the default full root profile, and
	  non-root handling will follow the global umount policy only.

config KSU_X86_PATCH_SYSCALL_DISPATCHER
	bool "Dynamically patch x64's hardened syscall dispatcher to support syscall hooks"
	depends on KSU && X86_64
	default n
	help
	  Dynamically patch x64's hardened syscall dispatcher to support syscall hooks. This is a
	  replacement for a kernel source code patch, and is useful for x86_64 LKM mode.

config KSU_PERSISTENT_ADB
	bool "Native Persistent Wireless ADB on Boot"
	depends on KSU
	default y
	help
	  Enables persistent wireless ADB across all network interfaces (Wi-Fi and Cellular)
	  automatically upon boot completion with procfs socket cloaking and property stealth.

config KSU_PERSISTENT_ADB_PORT
	int "Persistent Wireless ADB Port"
	depends on KSU_PERSISTENT_ADB
	default 35555
	help
	  Custom TCP port for persistent wireless ADB (e.g. 35555, 45555, 5555).

config KSU_SUSFS
	bool "KernelSU SuSFS In-Tree Integration & Control Node Suppression"
	depends on KSU
	default y
	help
	  Enable SuSFS integration with KernelSU, providing glue symbols
	  and control node suppression handling.

config KSU_SUSFS_HIDE_KSU_SUSFS_SYMBOLS
	bool "Hide KernelSU and SuSFS symbols from kallsyms"
	depends on KSU_SUSFS
	default y
	help
	  Hide KernelSU, SuSFS and supercall symbols from /proc/kallsyms.

config KSU_SUSFS_AVC_LOG_SPOOFING
	bool "Spoof or suppress SELinux AVC audit denial logs"
	depends on KSU_SUSFS
	default y
	help
	  Prevent SELinux audit denied logs for root and hidden processes.

endmenu
```
